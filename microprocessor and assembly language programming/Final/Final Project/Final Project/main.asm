;
; Final Project.asm
;
; Created: 02/11/1395 07:25:10 ب.ظ
; Author : Zahra
;

.INCLUDE "M32DEF.INC"
.ORG 0X00
.DEF RESULT=R20
 LDI R17,0X20
 LDI R16,LOW(RAMEND)
 OUT SPL,R16
 LDI R16,HIGH(RAMEND)
 OUT SPH,R16



LDI R16,0XFF
OUT DDRD,R16  ;PORTD خروجی



LDI R16,0XFF
OUT DDRB,R16  ;PORTB خروجی



LDI R16,0XFF
OUT DDRA,R16
OUT PORTA,R16 

RJMP SHOW

SELECT:
LDI R16,0X00
OUT DDRA,R16

LOOP:
IN R25,PINA
CPI R25,0XFF
BRSH LOOP
RJMP CHECK




CHECK:
LDI R16,0X00
LDI ZL,0X00
LDI ZH,0X00
LDI ZL,LOW(COUNTER_BEGIN)
LDI ZH,HIGH(COUNTER_BEGIN)
COM R25
ADD ZL,R25
ADC ZH,R16



IJMP

COUNTER_BEGIN:
NOP
RJMP FPSB ;first push down button
RJMP SPSB ;second push down button 
NOP
NOP
RJMP TPSB ;third push down button
TPSB:
LDI R17,0X00
RJMP SHOW
RET

SPSB:
CPI R17,1
BRSH CONTINUE1

LDI R17,0X99
RJMP SHOW
RET

CONTINUE1:
MOV R18,R17
ANDI R18,0X0F 
CPI R18,1
BRLO CONTINUE2

DEC R17
RJMP SHOW


CONTINUE2:
MOV R19,R17
SWAP R19 
ANDI R19,0X0F
DEC R19
SWAP R19
LDI R18,0X09
ADD R18,R19
MOV R17,R18
RJMP SHOW
RET


FPSB:
CPI R17,9
BRSH CONTINUE3

INC R17
RJMP SHOW
RET

CONTINUE3:
MOV R18,R17
MOV R19,R17
ANDI R18,0X0F
CPI R18,9
BRSH CONTINUE4

INC R17
RJMP SHOW
RET

CONTINUE4:
LDI R18,0X00
SWAP R19
ANDI R19,0X0F
INC R19
CPI R19,9
SWAP R19
ADD R18,R19
MOV R17,R18
RJMP SHOW
RET


SHOW:

LDI ZL,0X00
LDI ZH,0X00
LDI R16,0XFF
OUT DDRC,R16
SBI PORTC,0
MOV R20,R17
ANDI R20,0X0F
RJMP CODE1


TWO:
LDI ZL,0X00
LDI ZH,0X00
LDI R16,0XFF
SBI PORTC,0
LDI R20,0
MOV R20,R17
SWAP R20
ANDI R20,0X0F
RJMP CODE2

END:
LDI R16,0XFF
OUT DDRA,R16
LDI R16,0XFF
OUT PORTA,R16 
RJMP SELECT



CODE1:

LDI ZL,LOW(TABLE)
LDI ZH,HIGH(TABLE)

LDI R16,0
ADD ZL,R20
ADC ZH,R16

IJMP
TABLE:
RJMP SEND0
RJMP SEND1
RJMP SEND2
RJMP SEND3
RJMP SEND4
RJMP SEND5
RJMP SEND6
RJMP SEND7
RJMP SEND8
RJMP SEND9

SEND0:LDI RESULT,0X7E
OUT PORTD,RESULT
RJMP TWO

SEND1:LDI RESULT,0X30
OUT PORTD,RESULT
RJMP TWO

SEND2:LDI RESULT,0X6D
OUT PORTD,RESULT
RJMP TWO

SEND3:LDI RESULT,0X79
OUT PORTD,RESULT
RJMP TWO

SEND4:LDI RESULT,0X33
OUT PORTD,RESULT
RJMP TWO

SEND5:LDI RESULT,0X5B
OUT PORTD,RESULT
RJMP TWO

SEND6:LDI RESULT,0X5F
OUT PORTD,RESULT
RJMP TWO


SEND7:LDI RESULT,0X70
OUT PORTD,RESULT
RJMP TWO

SEND8:LDI RESULT,0X7F
OUT PORTD,RESULT
RJMP TWO

SEND9:LDI RESULT,0X7B
OUT PORTD,RESULT
RJMP TWO



CODE2:

LDI ZL,LOW(TABLE2)
LDI ZH,HIGH(TABLE2)

LDI R16,0
ADD ZL,R20
ADC ZH,R16

IJMP
TABLE2:
RJMP SEND20
RJMP SEND21
RJMP SEND22
RJMP SEND23
RJMP SEND24
RJMP SEND25
RJMP SEND26
RJMP SEND27
RJMP SEND28
RJMP SEND29

SEND20:LDI RESULT,0X7E
OUT PORTB,RESULT
RJMP DELAY

SEND21:LDI RESULT,0X30
OUT PORTB,RESULT
RJMP DELAY

SEND22:LDI RESULT,0X6D
OUT PORTB,RESULT
RJMP DELAY

SEND23:LDI RESULT,0X79
OUT PORTB,RESULT
RJMP DELAY

SEND24:LDI RESULT,0X33
OUT PORTB,RESULT
RJMP DELAY

SEND25:LDI RESULT,0X5B
OUT PORTB,RESULT
RJMP DELAY

SEND26:LDI RESULT,0X5F
OUT PORTB,RESULT
RJMP DELAY


SEND27:LDI RESULT,0X70
OUT PORTB,RESULT
RJMP DELAY

SEND28:LDI RESULT,0X7F
OUT PORTB,RESULT
RJMP DELAY

SEND29:LDI RESULT,0X7B
OUT PORTB,RESULT
RJMP DELAY



DELAY:
LDI R23,0XFF
LOOP1:
LDI R24,0XFF
LOOP2:
DEC R24
BRNE LOOP2
DEC R23
BRNE LOOP1
RJMP END

